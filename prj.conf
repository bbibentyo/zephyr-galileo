## CMakeLists.txt
```
cmake_minimum_required(VERSION 3.13.1)

find_package(Zephyr REQUIRED HINTS $ENV{ZEPHYR_BASE})
include(${ZEPHYR_BASE}/cmake/cfb.cmake NO_POLICY_SCOPE)
project(galileo)

FILE(GLOB app_sources src/*.c)
target_sources(app PRIVATE ${app_sources})

set(gen_dir ${ZEPHYR_BINARY_DIR}/include/generated/)
generate_cfb_font_for_target(app img/face_shot_clear.png ${gen_dir}/cfb_image.h 112 96 --first 49 --last 54)
```

## prj.conf
```kconfig
CONFIG_STDOUT_CONSOLE=y
CONFIG_HEAP_MEM_POOL_SIZE=16384
CONFIG_MAIN_STACK_SIZE=2048

CONFIG_SENSOR=y
CONFIG_GPIO=y
CONFIG_I2C=y
CONFIG_TI_HDC=y

CONFIG_SPI=y
CONFIG_DISPLAY=y
CONFIG_SSD16XX=y
CONFIG_CHARACTER_FRAMEBUFFER=y

CONFIG_FXOS8700=y
CONFIG_FXOS8700_MODE_ACCEL=y

CONFIG_FXOS8700_TRIGGER_OWN_THREAD=y

CONFIG_NEWLIB_LIBC=y

# Networking config
CONFIG_NETWORKING=y
CONFIG_NET_IPV4=y
CONFIG_NET_IPV6=n
CONFIG_NET_TCP=y
CONFIG_NET_ARP=y
CONFIG_NET_UDP=y
CONFIG_NET_DHCPV4=y
CONFIG_NET_SHELL=y
CONFIG_NET_MGMT=y
CONFIG_NET_MGMT_EVENT=y

# Sockets
CONFIG_NET_SOCKETS=y
CONFIG_NET_SOCKETS_POSIX_NAMES=y
CONFIG_NET_SOCKETS_POLL_MAX=4

# Network driver config
CONFIG_TEST_RANDOM_GENERATOR=y
CONFIG_INIT_STACKS=y

# Network address config
CONFIG_NET_CONFIG_SETTINGS=y
CONFIG_NET_CONFIG_NEED_IPV4=y
CONFIG_NET_CONFIG_NEED_IPV6=n
# CONFIG_NET_CONFIG_MY_IPV4_ADDR="0.0.0.0"
# CONFIG_NET_CONFIG_MY_IPV4_GW="0.0.0.0"
# Address of HTTP IPv4 server
CONFIG_NET_CONFIG_PEER_IPV4_ADDR="192.168.10.10"

# HTTP
CONFIG_HTTP_CLIENT=y

# Network debug config
CONFIG_LOG=y
CONFIG_LOG_IMMEDIATE=y
CONFIG_NET_LOG=y
CONFIG_NET_SOCKETS_LOG_LEVEL_DBG=n
CONFIG_NET_HTTP_LOG_LEVEL_DBG=n
```

## src/main.c
```c
#include <stdio.h>
#include <linker/sections.h>
#include <errno.h>
#include <zephyr.h>
#include <sys/printk.h>
#include <device.h>
#include <drivers/sensor.h>
#include <drivers/gpio.h>
#include <logging/log.h>

LOG_MODULE_REGISTER(galileo, LOG_LEVEL_INF);

#include "cfb_image.h"
#include "display.h"
#include "http_util.h"
#include "dhcp_config.h"

#define TEMP_DEVICE_NAME "HDC1010"
#define ACCE_DEVICE_NAME "MMA8652FC"
#define DISP_DEVICE_NAME "SSD16XX"

const struct device *temp_humidity_device;
const struct device *accelerometer_device;
const struct device *display_device;

char* convert_to_string(struct sensor_value *temp, struct sensor_value *hum){
	char *buf = k_malloc(100);
	char *values = "\"0x0001,%d.%d,%d.%d,1,0x0002:11\"";
	sprintf(buf, values, temp->val1, temp->val2, hum->val1, hum->val2);
	return buf;
}

void post_data(struct sensor_value *temp, struct sensor_value *hum, struct sensor_value coord[3]) {
	// char *json_data = dump_to_json(temp, hum, coord);
	char *json_data = convert_to_string(temp, hum);
	LOG_INF("sensor values posted: %s", json_data);
	int response;
	response = post_sensor_data(json_data);
	LOG_INF("---------- data posted ---------");
	k_free(json_data);
}

void main(void)
{
	LOG_INF("Initializing DHCP to obtain IP address");
	initialize_dhcp();

	temp_humidity_device = device_get_binding(TEMP_DEVICE_NAME);
	if (temp_humidity_device == NULL) {
		printk("Failed to initialize Temperature & Humidity device... aborting!\n");
		return;
	} else {
		printk("Temperature and humidity device has been initialized\n");
	}

	accelerometer_device = device_get_binding(ACCE_DEVICE_NAME);
	if(accelerometer_device == NULL){
		printk("Failed to initialize accelerometer device\n");
		return;
	} else {
		printk("Accelerometer has been initialized to %s\n", ACCE_DEVICE_NAME);
	}

	display_device = device_get_binding(DISP_DEVICE_NAME);
	if (display_device == NULL) {
		printk("Failed to initialize display device");
		return;
	} else {
		printk("Display device has been initialized... %s\n", DISP_DEVICE_NAME);
		if (cfb_framebuffer_init(display_device)) {
			printk("Framebuffer initialization failed\n");
			return;
		}
		display_blanking_off(display_device);
	}

	bool server_status = ping_http_server() >= 0;
	
	struct sensor_value temp;
	struct sensor_value humidity;
	struct sensor_value coord[3];
	char name[] = "Boss Bibentyo";

	while(1) {
		printk("Fetching temperature & humidity...\n");
		sensor_sample_fetch(temp_humidity_device);
		sensor_channel_get(temp_humidity_device, SENSOR_CHAN_AMBIENT_TEMP, &temp);
		sensor_channel_get(temp_humidity_device, SENSOR_CHAN_HUMIDITY, &humidity);

		printk("Fetching accelerometer data...\n");
		sensor_sample_fetch(accelerometer_device);
		sensor_channel_get(accelerometer_device, SENSOR_CHAN_ACCEL_XYZ, coord);

		cfb_framebuffer_clear(display_device, true);

		cfb_framebuffer_set_font(display_device, 0);
		cfb_print(display_device, "1", 0, LINE_HEIGHT);
	
		cfb_framebuffer_set_font(display_device, 2);
		write_name_to_screen(display_device, name);
		cfb_framebuffer_set_font(display_device, 1);
		write_separator(display_device);
		write_temp_to_screen(display_device, &temp);
		write_humidity_to_screen(display_device, &humidity);
		write_coordinates_to_screen(display_device, coord);	
		cfb_framebuffer_finalize(display_device);

		post_data(&temp, &humidity, coord);
		
		k_sleep(K_SECONDS(10));
	}
}
```

## src/dhcp_config.h
```c
#include <zephyr.h>
#include <net/net_if.h>
#include <net/net_core.h>
#include <net/net_context.h>
#include <net/net_mgmt.h>
#include <device.h>

static struct net_mgmt_event_callback mgmt_cb;

static void dhcp_handler(struct net_mgmt_event_callback *cb, 
							uint32_t mgmt_event, 
							struct net_if *iface){
	int i = 0;
	if (mgmt_event != NET_EVENT_IPV4_ADDR_ADD) {
		printk("not listening to right event\n");
		return;
	}

	for (i = 0; i < NET_IF_MAX_IPV4_ADDR; i++) {
		char buf[NET_IPV4_ADDR_LEN];

		if (iface->config.ip.ipv4->unicast[i].addr_type != NET_ADDR_DHCP) {
			continue;
		}

		printk("Assigned address: %s\n", 
				log_strdup(
					net_addr_ntop(AF_INET, &iface->config.ip.ipv4->unicast[i].address.in_addr, buf, sizeof(buf))));
		
		printk("Lease time: %u hours\n", iface->config.dhcpv4.lease_time / 60 / 60);
		printk("Subnet: %s\n", 
				log_strdup(
					net_addr_ntop(AF_INET, &iface->config.ip.ipv4->netmask, buf, sizeof(buf))));
		printk("Gateway: %s\n", 
				log_strdup(
					net_addr_ntop(AF_INET, &iface->config.ip.ipv4->gw, buf, sizeof(buf))));
	}
}

void initialize_dhcp() {
    struct net_if *iface;
	net_mgmt_init_event_callback(&mgmt_cb, dhcp_handler, NET_EVENT_IPV4_ADDR_ADD);
	net_mgmt_add_event_callback(&mgmt_cb);
	iface = net_if_get_default();
	net_dhcpv4_start(iface);
}
```

## src/display.h
```c
#include <drivers/sensor.h>
#include <display/cfb.h>

#define DEVICE_NAME "Zephyr Gateway"

const uint8_t NAME_STARTING_INDEX = 40;
const uint8_t RIGHT_SIDE_STARTING_INDEX = 120;
const uint8_t CHAR_LENGTH = 15;
const uint8_t LINE_HEIGHT = 24;

/*
* Because sensor value decimals are very long on display screen,
* I am only print the first two values
*/

uint32_t get_first_two_digits(uint32_t value) {
    uint32_t remainder = value;

    while (remainder >= 100) {
        remainder /= 10;
    }
    return remainder;
}

void write_name_to_screen(const struct device *dev, char *name) {
    printk("writing name \"%s\" to display\n", name);
    cfb_print(dev, name, NAME_STARTING_INDEX, 0);
}

void write_temp_to_screen(const struct device *dev, struct sensor_value *temp) {
    char temperature[CHAR_LENGTH];
    sprintf(temperature, "Temp: %d.%d", temp->val1, get_first_two_digits(temp->val2));
    printk("writing temp %d.%d to display\n", temp->val1, temp->val2);
    cfb_print(dev, temperature, RIGHT_SIDE_STARTING_INDEX, LINE_HEIGHT);
}

void write_humidity_to_screen(const struct device *dev, struct sensor_value *hum) {
    char humidity[CHAR_LENGTH];
    sprintf(humidity, "Hum : %d.%d", hum->val1, get_first_two_digits(hum->val2));
    printk("writing humidity %d.%d to display\n", hum->val1, hum->val2);
    cfb_print(dev, humidity, RIGHT_SIDE_STARTING_INDEX, LINE_HEIGHT + 16);
}

char * dump_to_json(struct sensor_value *temp, struct sensor_value *hum, struct sensor_value coord[3]) {
	char *buf = k_malloc(100);
	char *template = "{\"Temp\": %d.%d, \"Hum\": %d.%d, \"X\": %d.%d, \"Y\": %d.%d, \"Z\": %d.%d, \"device\": \"%s\"}";
    sprintf(buf, template, 
            temp->val1, get_first_two_digits(temp->val2), 
            hum->val1, get_first_two_digits(hum->val2),
            coord[0].val1, get_first_two_digits(coord[0].val2),
            coord[1].val1, get_first_two_digits(coord[1].val2),
            coord[2].val1, get_first_two_digits(coord[2].val2),
            DEVICE_NAME
    );
    return buf;
}

void write_coordinates_to_screen(const struct device *dev, struct sensor_value coord[3]) {
    char x[CHAR_LENGTH], y[CHAR_LENGTH], z[CHAR_LENGTH];
    sprintf(x, "AX  : %02d.%d", coord[0].val1, get_first_two_digits(coord[0].val2));
    sprintf(y, "AY  : %02d.%d", coord[1].val1, get_first_two_digits(coord[1].val2));
    sprintf(z, "AZ  : %02d.%d", coord[2].val1, get_first_two_digits(coord[2].val2));
    printk("AX = %d.%d, AY = %d.%d, AZ = %d.%d\n", 
            coord[0].val1, coord[0].val2,
            coord[1].val1, coord[1].val2,
            coord[2].val1, coord[2].val2);
    cfb_print(dev, x, RIGHT_SIDE_STARTING_INDEX, LINE_HEIGHT + 16*2);
    cfb_print(dev, y, RIGHT_SIDE_STARTING_INDEX, LINE_HEIGHT + 16*3);
    cfb_print(dev, z, RIGHT_SIDE_STARTING_INDEX, LINE_HEIGHT + 16*4);
}

void write_separator(const struct device *dev) {
    uint8_t starting_index = RIGHT_SIDE_STARTING_INDEX-16;
    uint8_t max_rows = cfb_get_display_parameter(dev, CFB_DISPLAY_ROWS);
    for(uint8_t i = 0; i < max_rows; i++) {
        cfb_print(dev, "|", starting_index, LINE_HEIGHT + (i*16));
    }
    printk("separating marks have been written to display\n");
}
```

## src/http_util.h
```c
#include <zephyr.h>
#include <string.h>

#include <logging/log.h>
#include <net/socket.h>
#include <net/net_ip.h>
#include <net/http_client.h>
#include <net/tls_credentials.h>
#include <kernel.h>

#define HTTP_PORT 8000
#define HTTP_PROTOCOL "HTTP/1.2"

#define MAX_RECV_BUF_LEN 512

#define REMOTE_SERVER_ADDRESS  CONFIG_NET_CONFIG_PEER_IPV4_ADDR

static uint8_t recv_buf_ipv4[MAX_RECV_BUF_LEN];

char *http_headers[] = {
    "Content-Length: 30\r\n",
    "Content-Type: application/json\r\n",
    "Authorization: Token 439c3b239670205ec60a0510cabdab6d220da5c2\r\n",
    NULL
};

void error(const char *msg) {
    printk("%s\n", msg);
}

static int setup_socket(sa_family_t family, const char *server, int port, int *sock, 
                        struct sockaddr *addr, socklen_t addr_len) {
    // const char *family_str = "IPv4";

    memset(addr, 0, addr_len);

    net_sin(addr)->sin_family = AF_INET;
    net_sin(addr)->sin_port = htons(port);
    inet_pton(family, server, &net_sin(addr)->sin_addr);
    *sock = socket(family, SOCK_STREAM, IPPROTO_TCP);
    return 0;
}

static int payload_callback(int sock, struct http_request *req, void *user_data) {
    (void)send(sock, user_data, strlen(user_data), 0);
    return 0;
}

static void response_callback(struct http_response *resp, enum http_final_call final_data, void *user_data){
    if (final_data == HTTP_DATA_MORE) {
        LOG_DBG("partial data recieved (%zd bytes)", resp->data_len);
    } else if (final_data == HTTP_DATA_FINAL) {
        LOG_INF("All data has been received (%zd bytes), status: %s", resp->data_len, resp->http_status);
    }

    LOG_INF("Response to %s", (const char *)user_data);
}

static int connect_socket(sa_family_t family, const char *server, int port, int *sock, struct sockaddr *addr, socklen_t addr_len){
    int res;
    res = setup_socket(family, server, port, sock, addr, addr_len);
    if (res < 0 || *sock < 0) {
        LOG_ERR("unable to setup socket");
        return -1;
    }
    res = connect(*sock, addr, addr_len);
    if (res < 0) {
        LOG_ERR("can not connect to IPv4 remote (%d)", -errno);
        res = -errno;
    }
    return res;
}

int ping_http_server() {
    struct sockaddr_in addr4;
    int sock4 = -1;
    int32_t timeout = 3 * MSEC_PER_SEC;
    int ret;
    int port = HTTP_PORT;

    connect_socket(AF_INET, REMOTE_SERVER_ADDRESS, port, &sock4, (struct sockaddr *)&addr4, sizeof(addr4));

    if(sock4 < 0) {
        LOG_ERR("cannot create HTTP connection");
        return -1;
    }

    struct http_request req;
    memset(&req, 0, sizeof(req));

    req.method = HTTP_GET;
    req.url = "/ping/";
    req.host = REMOTE_SERVER_ADDRESS;
    req.protocol = HTTP_PROTOCOL;
    req.response = response_callback;
    req.recv_buf = recv_buf_ipv4;
    req.recv_buf_len = sizeof(recv_buf_ipv4);
    ret = http_client_req(sock4, &req, timeout, "IPv4 GET");
    close(sock4);
    return ret;
} 

int post_sensor_data(char *data) {
    struct sockaddr_in addr4;
    int sock4 = -1;
    int32_t timeout = 3 * MSEC_PER_SEC;
    int ret;
    int port = HTTP_PORT;

    connect_socket(AF_INET, REMOTE_SERVER_ADDRESS, port, &sock4, (struct sockaddr *)&addr4, sizeof(addr4));

    if(sock4 < 0) {
        LOG_ERR("cannot create HTTP connection");
        return -1;
    }

    struct http_request req;
    memset(&req, 0, sizeof(req));

    struct http_request request;
    memset(&request, 0, sizeof(request));

    request.method = HTTP_POST;
    request.url = "/api/remote/upload/";
    request.host = REMOTE_SERVER_ADDRESS;
    request.protocol = HTTP_PROTOCOL;
    request.content_type_value = "application/json";
    request.payload = data;
    request.payload_len = strlen(data);
    request.response = response_callback;
    request.recv_buf = recv_buf_ipv4;
    request.recv_buf_len = sizeof(recv_buf_ipv4);
    char content_length[30];
    sprintf(content_length, "Content-Length: %d\r\n", strlen(data));
    http_headers[0] = content_length;

    request.header_fields = http_headers;
    ret = http_client_req(sock4, &request, timeout, "IPv4 POST");
    close(sock4);
    return ret;
}
```
